#include <dt-bindings/zmk/input_transform.h>
#include <input/processors/runtime-input-processor.dtsi>

&scroll_runtime_input_processor {
    scale-divisor = <30>;
};

&pointing_listener {
    input-processors =
        <&zip_xy_transform (INPUT_TRANSFORM_XY_SWAP)>,
        <&gesture_2_processor>,
        <&gesture_1_processor>,
        <&zip_temp_layer 1 30000>,
        <&mouse_runtime_input_processor>;

    scroller {
        layers = <2>;
        input-processors =
            <&zip_xy_transform (INPUT_TRANSFORM_XY_SWAP | INPUT_TRANSFORM_Y_INVERT)>,
            <&zip_xy_to_scroll_mapper>,
            <&scroll_runtime_input_processor>;
        process-next;
    };
};
