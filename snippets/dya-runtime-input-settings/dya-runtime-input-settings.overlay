#include <dt-bindings/zmk/input_transform.h>
#include <input/processors/runtime-input-processor.dtsi>

&mouse_runtime_input_processor {
    scale-multiplier = <1>;
    scale-divisor = <1>;
    track-remainders;
};

&scroll_runtime_input_processor {
    scale-multiplier = <1>;
    scale-divisor = <40>;
    track-remainders;
};

&pointing_listener {
    input-processors =
        <&zip_xy_transform (INPUT_TRANSFORM_XY_SWAP)>,
        <&pmw_gesture_2_processor>,
        <&pmw_gesture_1_processor>,
        <&zip_temp_layer 1 10000>,
        <&mouse_runtime_input_processor>;

    scroller {
        layers = <2>;
        input-processors =
            <&zip_xy_transform (INPUT_TRANSFORM_XY_SWAP | INPUT_TRANSFORM_Y_INVERT)>,
            <&zip_xy_to_scroll_mapper>,
            <&scroll_runtime_input_processor>;
        process-next;
    };
};
