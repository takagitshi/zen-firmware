## Kconfig
```kconfig
# Sensor data simulator
#
# Copyright (c) 2019 Nordic Semiconductor
#
# SPDX-License-Identifier: LicenseRef-Nordic-5-Clause
#

config ZMK_INPUT_PROCESSOR_GESTURE
    bool "Gesture input processor"
    default y
    depends on DT_HAS_ZMK_INPUT_PROCESSOR_GESTURE_ENABLED
    help
      Enable the layer-aware pointing gesture input processor.

menuconfig IQS7211E
    bool "IQS7211E capcacitive touch sensor"
    select I2C
    help
      Enable IQS7211E capcacitive touch sensor.

if IQS7211E

config IQS7211E_TAP_EDGE_MARGIN_PERMILLE
    int "Tap ignore edge margin (permille)"
    range 0 450
    default 80
    help
      Edge margin used to suppress tap/click detection in scroller mode.
      80 means 8 percent margin from each edge.

config IQS7211E_SCROLLER_HWHEEL_ZONE_MIN_PERMILLE
    int "HWheel zone start (permille)"
    range 0 1000
    default 0
    help
      Start position of the horizontal scroll zone in permille of Y size.
      This value and MAX define a band [MIN, MAX).

config IQS7211E_SCROLLER_HWHEEL_ZONE_MAX_PERMILLE
    int "HWheel zone end (permille)"
    range 0 1000
    default 150
    help
      End position of the horizontal scroll zone in permille of Y size.
      This value and MIN define a band [MIN, MAX).

config IQS7211E_TWO_FINGER_SCROLL_DIVIDER
    int "Two-finger scroll delta divider"
    range 1 64
    default 8
    help
      Scales down the default two-finger scroll path without affecting
      one-finger pointer movement. Higher values make scroll slower.

config IQS7211E_TAP_SUPPRESS_DISTANCE
    int "Tap suppress distance after scroll gesture"
    range 1 512
    default 24
    help
      Raw two-finger movement distance required before tap recognition is
      suppressed until all fingers are released. Higher values make tap
      recognition more permissive during small scroll gestures.

config IQS7211E_TWO_FINGER_SCROLL_JUMP_THRESHOLD
    int "Two-finger scroll jump threshold"
    range 1 2048
    default 180
    help
      Ignore a two-finger scroll sample when either axis delta exceeds this
      raw threshold. This helps suppress release-time coordinate jumps that
      can produce one large unintended scroll event.

config IQS7211E_SCROLLER_INERTIA
    bool "Enable inertia scrolling in scroller mode"
    default n
    help
      Keep sending wheel events after finger release when the device is in
      scroller mode. Uses fixed-point integer math (no FPU required).

config IQS7211E_SCROLLER_INERTIA_DECAY_PERMILLE
    int "Inertia decay coefficient (permille)"
    range 1 999
    default 920
    depends on IQS7211E_SCROLLER_INERTIA
    help
      Velocity multiplier applied every 10ms tick.
      920 means velocity = velocity * 0.92 per tick.

config IQS7211E_SCROLLER_INERTIA_STOP_THRESHOLD_Q8
    int "Inertia stop threshold (Q8 wheel units per 10ms)"
    range 1 4096
    default 96
    depends on IQS7211E_SCROLLER_INERTIA
    help
      Inertia stops immediately when absolute velocity goes below this value.
      Q8 means 256 equals 1 wheel unit per 10ms.

endif
```

## config/west.yml
```yaml
manifest:
  remotes:
    - name: zmkfirmware
      url-base: https://github.com/zmkfirmware
    - name: sekigon-gonnoc
      url-base: https://github.com/sekigon-gonnoc
    - name: kot149
      url-base: https://github.com/kot149
    - name: kumamuk-git
      url-base: https://github.com/kumamuk-git
    - name: badjeff
      url-base: https://github.com/badjeff
    - name: cormoran
      url-base: https://github.com/cormoran
  projects:
    - name: zmk
      remote: cormoran
      revision: e5c9b6915b56801193e359dd9bad4a167ce0d1b8
      import:
        file: app/west.yml
        name-blocklist:
          - ci-tools
          - hal_altera
          - hal_cypress
          - hal_infineon
          - hal_microchip
          - hal_nxp
          - hal_openisa
          - hal_silabs
          - hal_xtensa
          - hal_st
          - hal_ti
          - loramac-node
          - mcuboot
          - mcumgr
          - net-tools
          - openthread
          - edtt
          - trusted-firmware-m
    - name: zmk-component-bmp-boost
      remote: sekigon-gonnoc
      import: west.yml
      revision: 2f5567523b6f0bc39575d48ed746ed9d635edf8b
    - name: zmk-feature-custom-settings
      remote: cormoran
      revision: c6a7fef3a3be3d3ace5de9a4b0628c6418cd1f3f
    - name: zmk-module-settings-rpc
      remote: cormoran
      revision: 78f86df9e6c5edaf57bef3ccbd7f360cfdf49291
    - name: zmk-module-runtime-input-processor
      remote: cormoran
      revision: 43618985f8c9d5457cc333b7ca0733f2d361911e
    - name: zmk-feature-status-led
      remote: sekigon-gonnoc
      revision: main
    - name: zmk-driver-paw3222
      remote: sekigon-gonnoc
      revision: torabo-tsuki
    - name: zmk-feature-cdc-acm-bootloader-trigger
      remote: sekigon-gonnoc
      revision: 37ca1ef9e42d62040387590542585da033d12571
    - name: zmk-feature-non-lipo-battery-management
      remote: sekigon-gonnoc
      revision: main
    - name: zmk-scroll-snap
      remote: kot149
      revision: v1
  self:
    path: config
```

## dts/bindings/input_processors/zen,input-processor-runtime-scaler.yaml
```yaml
# Copyright (c) 2026 Takashi
# SPDX-License-Identifier: MIT

description: ZEN runtime-configurable input scaler

compatible: "zen,input-processor-runtime-scaler"

include: ip_zero_param.yaml

properties:
  type:
    type: int
    required: true
  codes:
    type: array
    required: true
```

## dts/bindings/input_processors/zmk,input-processor-gesture.yaml
```yaml
# Copyright (c) 2026 Takashi Imai
# SPDX-License-Identifier: MIT

description: Layer-aware pointing gesture input processor

compatible: "zmk,input-processor-gesture"

include: ip_zero_param.yaml

properties:
  layer:
    type: int
    required: true
    description: Layer ID on which the processor consumes relative X/Y input

  threshold:
    type: int
    required: true
    description: Manhattan distance required to recognize one gesture

  cooldown-ms:
    type: int
    required: true
    description: Motion discard interval after a direction is recognized

  reset-on-layer:
    type: int
    required: true
    description: Additional mutually exclusive layer whose transitions reset accumulated motion

  binding-layer:
    type: int
    required: true
    description: Keymap layer containing the editable gesture action slots

  left-position:
    type: int
    required: true
    description: Key position to invoke for a left gesture

  right-position:
    type: int
    required: true
    description: Key position to invoke for a right gesture
```

## dts/bindings/input_processors/zmk,input-processor-pointer-acceleration.yaml
```yaml
# Copyright (c) 2026 Takashi Imai
# SPDX-License-Identifier: MIT

description: Vector-speed pointer acceleration input processor

compatible: "zmk,input-processor-pointer-acceleration"

include: ip_zero_param.yaml

properties:
  base-multiplier-milli:
    type: int
    required: true
    description: Linear low-speed gain in thousandths, where 1000 means 1.0x

  takeoff-speed:
    type: int
    required: true
    description: Vector counts per completed report at or below which gain is exactly 1.0x

  full-speed:
    type: int
    required: true
    description: Vector counts per completed report at or above which maximum gain is used

  max-multiplier-milli:
    type: int
    required: true
    description: Maximum pointer gain in thousandths, where 2250 means 2.25x

  attack-smoothing-milli:
    type: int
    required: true
    description: Fraction of a gain increase applied per report, in thousandths

  release-smoothing-milli:
    type: int
    required: true
    description: Fraction of a gain decrease applied per report, in thousandths

  reference-interval-ms:
    type: int
    required: true
    description: Report interval used to normalize vector speed

  idle-reset-ms:
    type: int
    required: true
    description: Idle duration after which the next report starts at base gain
```

## dts/bindings/pixart,pmw3610-alt.yml
```yaml
description: |
  Sensor driver for the pixart PMW3610 mouse sensor

compatible: "pixart,pmw3610-alt"

include: spi-device.yaml

properties:
  irq-gpios:
    type: phandle-array
    required: true
  cpi:
    type: int
    default: 600
    description: "CPI value (Range: 200 - 3200, Step: 200)"
  swap-xy:
    type: boolean
  invert-x:
    type: boolean
  invert-y:
    type: boolean
  evt-type:
    type: int
    required: true
  x-input-code:
    type: int
    required: true
  y-input-code:
    type: int
    required: true
  force-awake:
    type: boolean
  force-awake-4ms-mode:
    type: boolean
  zen-pointer-acceleration:
    type: boolean
    description: Enable ZEN same-frame gain acceleration for this sensor instance
  zen-pointer-acceleration-base-gain-milli:
    type: int
    default: 1000
    description: Low-speed gain in thousandths
  zen-pointer-acceleration-takeoff-speed:
    type: int
    default: 32
    description: Normalized vector speed where the gain ramp starts
  zen-pointer-acceleration-full-speed:
    type: int
    default: 160
    description: Normalized vector speed where the output-speed slope reaches maximum gain
  zen-pointer-acceleration-max-gain-milli:
    type: int
    default: 1500
    description: Maximum output-speed slope and asymptotic multiplier in thousandths
  zen-pointer-acceleration-reference-interval-ms:
    type: int
    default: 15
    description: Reference interval used to normalize delayed reports
  zen-pointer-acceleration-idle-reset-ms:
    type: int
    default: 60
    description: Idle time that clears fractional remainder state
  zen-pointer-acceleration-scroll-layer:
    type: int
    default: 2
    description: Layer on which acceleration is bypassed for raw scrolling
  zen-pointer-acceleration-gesture-layer:
    type: int
    default: 3
    description: Layer on which acceleration is bypassed for raw gestures
```
